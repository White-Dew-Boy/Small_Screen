## main/Kconfig.projbuild
```kconfig
menu "WiFi Configuration"

    config WIFI_MAX_RETRY
        int "WiFi connection max retries"
        default 10
        range 1 100
        help
            Maximum number of connection attempts before giving up.
            After this the station stops retrying until a manual
            reconnect is requested.
            WiFi credentials are NOT compiled in — configure them
            at runtime from the LCD UI (they are stored in NVS).

endmenu

menu "MQTT Configuration"

    config MQTT_BROKER_URI
        string "MQTT broker URI"
        default ""
        help
            Full MQTT URI, e.g.:
              mqtt://192.168.1.100:1883        (plain TCP, LAN)
              mqtts://broker.example.com:8883  (TLS over TCP)
              wss://broker.example.com:443/mqtt (MQTT over WebSocket + TLS)
            TLS verification uses the ESP-IDF certificate bundle
            (trusts public CAs). Must match CONFIG_MQTT_USERNAME /
            CONFIG_MQTT_PASSWORD on the broker.
            No broker is compiled in by default: leave this empty and set the
            broker at runtime on the MQTT config page (stored in NVS; the NVS
            value overrides whatever is set here).

    config MQTT_USERNAME
        string "MQTT username"
        default ""
        help
            Username for broker authentication. Leave empty for
            anonymous access.

    config MQTT_PASSWORD
        string "MQTT password"
        default ""
        help
            Password for broker authentication. Leave empty for
            anonymous access. No credential is compiled in by default:
            set it at runtime on the MQTT config page (stored in NVS).

    config MQTT_TELEMETRY_INTERVAL
        int "Telemetry publish interval (seconds)"
        default 5
        range 1 3600
        help
            How often the device publishes temperature/humidity to
            the broker. The sensor is read every 2 s; publishing is
            rate-limited to this interval.

    config MQTT_PC_PERF_TOPIC
        string "PC performance subscribe topic"
        default "pc/performance"
        help
            Topic the device subscribes to (QoS 1) for PC performance
            data published by the PC tool, a flat JSON object:
              {"timestamp":..,"cpu":..,"memory":..,
               "upload_speed":..,"download_speed":..,"gpu":..,"disk":..}
            cpu/memory/gpu/disk are percent, upload_speed/download_speed
            are KB/s. Leave empty to disable the MQTT path (the PC-Perf
            page then falls back to BLE only).

endmenu

menu "Time Configuration"

    config TIME_TZ
        string "Time zone (POSIX TZ string)"
        default "CST-8"
        help
            POSIX timezone string used for local time display, e.g.:
              CST-8            China (UTC+8, no DST)
              UTC0             UTC / GMT
              EST5EDT,M3.2.0,M11.1.0   US Eastern (with DST)
            The Home page clock and every localtime() call use this zone.
            Requires SNTP time sync (WiFi connected).

    config TIME_NTP_SERVER
        string "NTP server"
        default "pool.ntp.org"
        help
            NTP server used to sync the wall-clock time after WiFi
            connects. On China networks ntp.aliyun.com usually works
            well too.

endmenu

menu "Upload Server Configuration"

    config UPLOAD_SERVER_PORT
        int "HTTP upload server port"
        default 80
        range 1 65535
        help
            TCP port the file upload/download server listens on. The
            device must be connected to WiFi; open http://<device-ip>:<port>/
            in a browser to upload files to the SD card.

    config UPLOAD_DIR
        string "Upload directory on SD card"
        default "/sdcard/esp32_files"
        help
            Flat directory where uploaded files are stored. Duplicate
            names get a numeric suffix automatically (file.txt,
            file_1.txt, ...). The directory is created if missing.

    config UPLOAD_MAX_SIZE_MB
        int "Maximum single-file upload size (MB)"
        default 64
        range 1 4000
        help
            Upper bound for one upload; larger requests are rejected
            before any data is written to the card.

endmenu

menu "Audio Player Configuration"

    config AUDIO_PLAYER_VOLUME
        int "WAV playback volume (percent of full scale)"
        default 40
        range 0 100
        help
            Software volume applied while streaming WAV data to the
            MAX98357A. The amp module defaults to 9 dB gain, so a
            full-scale file at 100% will clip on a small speaker; 40%
            is a safe default.
            Set to 0 to mute the stream while everything else keeps
            running: that is the quickest way to tell signal-related
            noise (distortion) from the amp/rail noise floor.
            The UI volume control (audio page) will override this at
            runtime once it exists.

endmenu
```
